//x=8
//y=8
fontstruct cfont_basic={8,{3,1,3,5,4,6,5,1,2,2,3,3,3,3,2,3,4,3,4,4,4,4,4,4,4,4,2,2,3,3,3,4,5,4,4,4,4,4,4,4,4,1,3,4,3,5,4,4,4,4,4,4,3,4,5,5,5,5,4,2,3,2,3,4,2,4,4,3,4,4,3,4,4,1,2,4,1,5,4,4,4,4,3,3,3,4,4,5,4,4,4,3,1,3,4,
},{0,24,32,56,96,128,176,216,224,240,256,280,304,328,352,368,392,424,448,480,512,544,576,608,640,672,704,720,736,760,784,808,840,880,912,944,976,1008,1040,1072,1104,1136,1144,1168,1200,1224,1264,1296,1328,1360,1392,1424,1456,1480,1512,1552,1592,1632,1672,1704,1720,1744,1760,1784,1816,1832,1864,1896,1920,1952,1984,2008,2040,2072,2080,2096,2128,2136,2176,2208,2240,2272,2304,2328,2352,2376,2408,2440,2480,2512,2544,2576,2600,2608,2632,
}};
const char cfont_basicc[]={0,0,0,0,0,0,0,0,0,0,0,0,0,0,0,0,
0,0,0,0,0,0,0,0,255,255,255,255,0,255,0,0,
255,0,255,255,0,255,0,0,0,0,0,0,0,0,0,0,
0,0,0,0,0,0,0,0,0,255,0,255,0,255,255,255,
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0,0,0,0,0,0,0,0,};
