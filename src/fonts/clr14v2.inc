//x=14
//y=14
fontstruct cfont_lr14v={14,{6,2,7,7,7,7,8,5,6,6,7,8,3,8,3,7,7,6,7,7,7,7,7,7,7,7,3,3,7,7,7,8,8,8,7,7,8,7,7,8,8,2,6,8,7,8,8,8,7,8,7,7,8,7,8,8,8,8,8,4,7,4,6,8,4,7,7,7,7,7,5,7,7,2,4,7,2,8,7,7,7,7,6,7,5,7,7,8,7,7,7,5,2,6,8,
},{0,84,112,210,308,406,504,616,686,770,854,952,1064,1106,1218,1260,1358,1456,1540,1638,1736,1834,1932,2030,2128,2226,2324,2366,2408,2506,2604,2702,2814,2926,3038,3136,3234,3346,3444,3542,3654,3766,3794,3878,3990,4088,4200,4312,4424,4522,4634,4732,4830,4942,5040,5152,5264,5376,5488,5600,5656,5754,5810,5894,6006,6062,6160,6258,6356,6454,6552,6622,6720,6818,6846,6902,7000,7028,7140,7238,7336,7434,7532,7616,7714,7784,7882,7980,8092,8190,8288,8386,8456,8484,8568,
}};
const char cfont_lr14vc[]={0,0,0,0,0,0,0,0,0,0,0,0,0,0,0,0,
0,0,0,0,0,0,0,0,0,0,0,0,0,0,0,0,
0,0,0,0,0,0,0,0,0,0,0,0,0,0,0,0,
0,0,0,0,0,0,0,0,0,0,0,0,0,0,0,0,
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0,0,0,0,0,0,0,0,};
