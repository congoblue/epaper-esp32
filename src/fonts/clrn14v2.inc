//x=14
//y=14
fontstruct cfont_lrn14v=
{14,{5,2,5,7,5,7,7,3,4,4,7,6,3,6,3,7,5,5,5,5,5,5,5,5,5,5,3,2,5,5,5,6,7,6,5,5,6,5,5,6,6,2,4,6,5,7,6,6,5,6,5,5,6,5,6,7,6,6,6,4,5,3,6,6,3,5,5,5,5,5,4,5,5,2,3,5,2,8,5,5,5,5,5,5,3,5,5,7,5,5,5,4,2,4,6,
},{0,70,98,168,266,336,434,532,574,630,686,784,868,910,994,1036,1134,1204,1274,1344,1414,1484,1554,1624,1694,1764,1834,1876,1904,1974,2044,2114,2198,2296,2380,2450,2520,2604,2674,2744,2828,2912,2940,2996,3080,3150,3248,3332,3416,3486,3570,3640,3710,3794,3864,3948,4046,4130,4214,4298,4354,4424,4466,4550,4634,4676,4746,4816,4886,4956,5026,5082,5152,5222,5250,5292,5362,5390,5502,5572,5642,5712,5782,5852,5922,5964,6034,6104,6202,6272,6342,6412,6468,6496,6552,
}};
const char cfont_lrn14vc[]={0,0,0,0,0,0,0,0,0,0,0,0,0,0,0,0,
0,0,0,0,0,0,0,0,0,0,0,0,0,0,0,0,
0,0,0,0,0,0,0,0,0,0,0,0,0,0,0,0,
0,0,0,0,0,0,0,0,0,0,0,0,0,0,0,0,
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0,0,0,0,0,0,0,0,0,0,0,0,};
